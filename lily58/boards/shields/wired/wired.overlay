/*
 * Add-on shield: full-duplex wired UART split transport.
 *
 * Stacked on top of the lily58_left / lily58_right shields, e.g.
 *   shield: lily58_left wired
 *
 * Uses the Pro-Micro interconnect's predefined UART (&pro_micro_serial),
 * available on both nice_nano_v2 and mikoto. Full-duplex requires both
 * data conductors (TX/RX) routed through the TRRS connector.
 */

&pro_micro_serial {
    status = "okay";
};

/ {
    wired_split {
        compatible = "zmk,wired-split";
        device = <&pro_micro_serial>;
    };
};

/*
 * The full-duplex revision uses D0/D1 for the UART, so the nice!view CS moved
 * off D1 (pro_micro 1, the stock nice_view_adapter default) to D4 (pro_micro 4).
 * SCK/MOSI (P0.20/P0.17) are unchanged. This must be listed AFTER the
 * `nice_view_adapter` shield so it overrides its cs-gpios.
 */
&nice_view_spi {
    cs-gpios = <&pro_micro 4 GPIO_ACTIVE_HIGH>;
};
